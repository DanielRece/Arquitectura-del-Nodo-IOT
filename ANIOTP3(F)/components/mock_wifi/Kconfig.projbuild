## ANIOTP3(F)/components/mock_wifi/Kconfig.projbuild
```kconfig
menu "Mock WiFi configuration"

    config ESP_WIFI_LATENCY
        int "Waiting time to simulate starting WiFi"
        range 0 20
        default 3
        help
            Define the delay to pretend to start WiFi in seconds, between 0 and 20 (default: 3).

    config ESP_GOTIP_LATENCY
        int "Waiting time to simulate getting an IP address"
        range 0 20
        default 1
        help
            Define the delay to pretend to get an IP address in seconds, between 0 and 20 (default: 1).
        
    config ESP_NETWORKDOWN_DELAY
        int "Time after which the mock network is simulated to fall down"
        range 0 60
        default 20
        help
            Define the period after which the network is simulatedly falling down,
            between 0 and 60 (default: 20).
                
    config ESP_GOTWIFI_RATE
        int "Percentage of times a wifi_connect call returns success"
        range 0 100
        default 95
        help
            Define the percentage of times that an invocation should return a succesful
            connection, between 0 and 100 (default: 95). Warning: this uses random values,
            so it is not guaranteed that 100 calls returns exactly 95 success and 5 fails.
        
endmenu
```

## ANIOTP3(F)/components/monitor_gpio/Kconfig.projbuild
```kconfig
menu "Configuración Monitor-GPIO"

config DETECCION
    int "Detección (s)"
    range 1 3600
    default 2
    help
        Indica el intervalo de detección del botón en segundos.
        
config GPIO_BOTON
    int "GPIO Botón"
    default 34
    help
        Indica GPIO que se utilizará como botón.

endmenu
```

## ANIOTP3_/hello_world/components/monitor_temperatura/Kconfig.projbuild
```kconfig
menu "Configuración Monitor-Temperatura"

config MUESTREO
    int "Muestreo (s)"
    range 1 3600
    default 10
    help
        Indica el intervalo entre sensorizaciones de la temperatura y humedad en segundos.

endmenu
```

## ANIOTP7(F)/components/monitor_gpio/Kconfig.projbuild
```kconfig
menu "Configuración Monitor-GPIO"

config DETECCION
    int "Detección (s)"
    range 1 3600
    default 2
    help
        Indica el intervalo de detección del botón en segundos.
        
config GPIO_BOTON
    int "GPIO Botón"
    default 34
    help
        Indica GPIO que se utilizará como botón.

config OTA_BOTON
    int "OTA Botón"
    default 32
    help
        Indica el GPIO que se utilizará como botón para OTA.

endmenu
```

## ANIOTP7(F)/components/ota_manager/Kconfig.projbuild
```kconfig
menu "OTA Manager Configuration"

    config EXAMPLE_FIRMWARE_UPGRADE_URL
        string "firmware upgrade url endpoint"
        default "https://192.168.0.3:8070/hello_world.bin"
        help
            URL of server which hosts the firmware
            image.

    config EXAMPLE_SKIP_COMMON_NAME_CHECK
        bool "Skip server certificate CN fieldcheck"
        default n
        help
            This allows you to skip the validation of OTA server certificate CN field.

endmenu
```
